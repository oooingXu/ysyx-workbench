## nemu/src/isa/riscv32/Kconfig
```kconfig
menu "ISA-dependent Options for riscv"

config RV64
  bool "64-bit RISC-V architecture"
  default n

config RVE
  bool "Use E extension"
  default n

config RVA
  bool "Use A extension"
  default n

config RVC
  bool "Use C extension"
  default n

config RVDF
  bool "Use DF extension"
  default n
endmenu

menu "CSR-dependent Options for riscv"

config MEPC
	bool "Use mepc csr"
	default y

config MCAUSE
	bool "Use mcause csr"
	default y

config MTVEC
	bool "Use mtvec csr"
	default y

config MSTATUS
	bool "Use mstatus csr"
	default y

config MIE
	bool "Use mie csr"
	default y

config MSCRATCH
	bool "Use mscratch csr"
	default y

config MTVAL
	bool "Use mtval csr"
	default y

config MIP
	bool "Use mip csr"
	default y

config MIMPID
	bool "Use mimpid csr"
	default n

config MHARTID
	bool "Use mhartid csr"
	default n

config MVENDORID
	bool "Use mvendorid csr"
	default n

config MARCHID
	bool "Use marchid csr"
	default n

endmenu
```

## npc/Kconfig
```kconfig
mainmenu "ysyx_23060336 Configuration Menu"

menu "Architecture"
config NPC
	bool "riscv32-npc"
	default n
config SOC
	bool "riscv32-ysyxsoc"
	default y
endmenu

menu "ISA-dependent Options for riscv"

config RVE
  bool "Use E extension"
  default n

endmenu

choice
	prompt "Running mode"
	default MODE_SYSTEM

config MODE_SYSTEM
	bool "System mode"
endchoice

menu "Testing and Debugging"

config TRACE
	bool "Enable tracer"
	default y

config ITRACE
	depends on TRACE
	bool "Enable instruction itracer"
	default y

config MTRACE
	depends on TRACE
	bool "Enable instruction mtracer"
	default n

config SMTRACE
	depends on MTRACE
	bool "Enable instruction sramtracer"
	default n

config PMTRACE
	depends on MTRACE
	bool "Enable instruction psramtracer"
	default n

config FMTRACE
	depends on MTRACE
	bool "Enable instruction flashtrace"
	default n

config COUNTER
	depends on TRACE
	bool "Enable instruction performance counter"
	default y

config PCOUNTER
	depends on COUNTER
	bool "Enable instruction performance counter"
	default n

config DTRACE
	depends on TRACE
	bool "Enable instruction dtracer"
	default n

config FTRACE
	depends on TRACE
	bool "Enable instruction ftracer"
	default n

config RTRACE
	depends on TRACE
	bool "Enable instruction rtracer"
	default n

config CTRACE
	depends on TRACE
	bool "Enable instruction ctrace"
	default n

config IRINGBUF
	depends on TRACE
	bool "Enable printf iringbuf when abort"
	default n

config IRINGBUF_DEBUG
	depends on IRINGBUF
	bool "Enable debug iringbuf"
	default n

config BATCH
 depends on TRACE
	bool "Enable batch"
	default y

config WATCHPOINT
 depends on !BATCH
	bool "Enable watchpoint"
	default n

config DIFFTEST
 depends on TRACE
 bool "Enable instruction difftest"
 default n

config PTRACE
	depends on DIFFTEST
	bool "Enable instruction ptracer"
	default n

config DIFFMEM_DEBUG
	depends on DIFFTEST
	bool "Enable printf diff mem"
	default n

config ABORTRUN
	depends on TRACE
	bool "Enable run when abort"
	default n

config WAVE
	depends on TRACE
	bool "Enable open gtkwave"
	default n

config LIGHTSSS
	depends on TRACE
	bool "Enable open lightsss"
	default n

config KONATA
	depends on TRACE
	bool "Enable Konata pipeline visualization"
	default n
	help
	  Enable Konata pipeline visualization logger.
	  This will generate a pipeline.log file in build/ directory
	  that can be opened with Konata tool for pipeline analysis.

endmenu

if MODE_SYSTEM
source "csrc/device/Kconfig"
endif
```
